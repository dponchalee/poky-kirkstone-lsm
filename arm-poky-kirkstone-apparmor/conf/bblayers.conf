## arm-poky-kirkstone-apparmor/conf/bblayers.conf
```bitbake
# POKY_BBLAYERS_CONF_VERSION is increased each time build/conf/bblayers.conf
# changes incompatibly
POKY_BBLAYERS_CONF_VERSION = "2"

BBPATH = "${TOPDIR}"
BBFILES ?= ""

BBLAYERS ?= " \
  ${TOPDIR}/../bitbake-kirkstone/layer/poky/meta \
  ${TOPDIR}/../bitbake-kirkstone/layer/poky/meta-poky \
  ${TOPDIR}/../bitbake-kirkstone/layer/poky/meta-yocto-bsp \
  ${TOPDIR}/../layer/meta-security \
  ${TOPDIR}/../layer/meta-openembedded/meta-python \
  ${TOPDIR}/../layer/meta-openembedded/meta-oe \
  ${TOPDIR}/../layer/meta-openembedded/meta-networking \
  ${TOPDIR}/../layer/meta-openembedded/meta-perl \
  "
```

## arm-poky-kirkstone-selinux/conf/bblayers.conf
```bitbake
# POKY_BBLAYERS_CONF_VERSION is increased each time build/conf/bblayers.conf
# changes incompatibly
POKY_BBLAYERS_CONF_VERSION = "2"

BBPATH = "${TOPDIR}"
BBFILES ?= ""

BBLAYERS ?= " \
  ${TOPDIR}/../bitbake-kirkstone/layer/poky/meta \
  ${TOPDIR}/../bitbake-kirkstone/layer/poky/meta-poky \
  ${TOPDIR}/../bitbake-kirkstone/layer/poky/meta-yocto-bsp \
  ${TOPDIR}/../layer/meta-selinux \
  ${TOPDIR}/../layer/meta-openembedded/meta-python \
  ${TOPDIR}/../layer/meta-openembedded/meta-oe \
  "
```

## arm-poky-kirkstone-tomoyo/conf/bblayers.conf
```bitbake
# POKY_BBLAYERS_CONF_VERSION is increased each time build/conf/bblayers.conf
# changes incompatibly
POKY_BBLAYERS_CONF_VERSION = "2"

BBPATH = "${TOPDIR}"
BBFILES ?= ""

BBLAYERS ?= " \
  /bdrive/nvme02/bitbake-kirkstone/layer/poky/meta \
  /bdrive/nvme02/bitbake-kirkstone/layer/poky/meta-poky \
  /bdrive/nvme02/bitbake-kirkstone/layer/poky/meta-yocto-bsp \
  ${TOPDIR}/../layer/meta-security \
  ${TOPDIR}/../layer/meta-openembedded/meta-python \
  ${TOPDIR}/../layer/meta-openembedded/meta-oe \
  ${TOPDIR}/../layer/meta-openembedded/meta-networking \
  ${TOPDIR}/../layer/meta-openembedded/meta-perl \
  "
```

## arm-poky-kirkstone/conf/bblayers.conf
```bitbake
# POKY_BBLAYERS_CONF_VERSION is increased each time build/conf/bblayers.conf
# changes incompatibly
POKY_BBLAYERS_CONF_VERSION = "2"

BBPATH = "${TOPDIR}"
BBFILES ?= ""

BBLAYERS ?= " \
  /bdrive/nvme02/bitbake-kirkstone/layer/poky/meta \
  /bdrive/nvme02/bitbake-kirkstone/layer/poky/meta-poky \
  /bdrive/nvme02/bitbake-kirkstone/layer/poky/meta-yocto-bsp \
  "
```
